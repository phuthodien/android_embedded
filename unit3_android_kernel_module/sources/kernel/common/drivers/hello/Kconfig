## unit3_android_kernel_module/sources/kernel/common/drivers/hello/Kconfig
```kconfig
# Device Hello configuration
# By BHien 
menuconfig HELLO
    tristate "Hello String"
    default y
    help
      Say Y to include this module
      Say N will not build this module
      Say M to build this module but not include to kernel yet
```
